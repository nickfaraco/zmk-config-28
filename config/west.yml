## config/west.yml
```yaml
manifest:
  defaults:
    revision: v0.3
  remotes:
    - name: zmkfirmware
      url-base: https://github.com/zmkfirmware
    # Additional modules containing boards/shields/custom code can be listed here as well
    # See https://docs.zephyrproject.org/3.2.0/develop/west/manifest.html#projects
  projects:
    - name: zmk
      remote: zmkfirmware
      import: app/west.yml
    - name: zmk-keyboard-chocofi
      url: https://github.com/s-gregorini003/zmk-keyboard-chocofi
      revision: main
      path: modules/zmk-keyboard-chocofi
    - name: zmk-tri-state
      url: https://github.com/urob/zmk-tri-state
      revision: main
      path: modules/zmk-tri-state
    - name: zmk-unicode
      url: https://github.com/urob/zmk-unicode
      revision: main
      path: modules/zmk-unicode
    - name: zmk-leader-key
      url: https://github.com/urob/zmk-leader-key
      revision: main
      path: modules/zmk-leader-key
    - name: zmk-helpers
      url: https://github.com/urob/zmk-helpers
      revision: main
      path: modules/zmk-helpers
  self:
    path: config
```
